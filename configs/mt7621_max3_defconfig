## configs/mt7621_max3_defconfig
```kconfig
CONFIG_MIPS=y
CONFIG_SPL_LDSCRIPT="arch/$(ARCH)/mach-mt7621/spl/u-boot-nand-spl.lds"
CONFIG_SPL_SERIAL_SUPPORT=y
CONFIG_SPL_SYS_MALLOC_F_LEN=0x100000
CONFIG_DEBUG_UART_BOARD_INIT=y
CONFIG_DEBUG_UART_BASE=0xbe000c00
CONFIG_DEBUG_UART_CLOCK=50000000
CONFIG_MACH_MT7621=y
CONFIG_BOARD_MT7621_NAND_TEMPLATE=y
CONFIG_MT7621_LEGACY_DRAMC_BIN=y
# CONFIG_MT7621_DRAMC_DEBUG_LEGACY is not set
CONFIG_MTKAUTOBOOT_DELAY=1
CONFIG_MIPS_BOOT_FDT=y
CONFIG_DEBUG_UART=y
# CONFIG_LOCALVERSION_AUTO is not set
CONFIG_NR_DRAM_BANKS=1
# CONFIG_EXPERT is not set
CONFIG_FIT=y
# CONFIG_ARCH_FIXUP_FDT_MEMORY is not set
CONFIG_NAND_BOOT=y
CONFIG_BOOTDELAY=3
CONFIG_USE_BOOTCOMMAND=y
CONFIG_BOOTCOMMAND="max3autoboot"
CONFIG_SYS_CONSOLE_INFO_QUIET=y
CONFIG_DISPLAY_CPUINFO=y
CONFIG_LAST_STAGE_INIT=y
CONFIG_SPL_NAND_SUPPORT=y
CONFIG_SPL_PAYLOAD="u-boot-lzma.img"
CONFIG_SPL_YMODEM_SUPPORT=y
CONFIG_CMD_BOOTMENU=y
# CONFIG_CMD_ELF is not set
# CONFIG_CMD_XIMG is not set
# CONFIG_CMD_FLASH is not set
CONFIG_CMD_GPIO=y
# CONFIG_CMD_NFS is not set
CONFIG_CMD_MTDPARTS=y
CONFIG_MTDIDS_DEFAULT="nand0=nand0"
CONFIG_MTDPARTS_DEFAULT="mtdparts=nand0:0x100000(uboot),0xa00000(boot),0xa00000(bootbk),0x180000(oeminfo),0x100000(mnvdload),0x100000(mnvbackup),0x100000(mnvdefault),0xa00000(mnvimg),0x500000(userbkdata),0xb00000(userdata),0x100000(wifi),0x1400000(app),0x1400000(webui),0x1400000(system),0x6000000(online),-(firmware)"
# CONFIG_PARTITIONS is not set
CONFIG_OF_CONTROL=y
CONFIG_OF_EMBED=y
CONFIG_DEFAULT_DEVICE_TREE="mt7621_nand_template"
CONFIG_NET_RANDOM_ETHADDR=y
# CONFIG_DM_WARN is not set
# CONFIG_OF_TRANSLATE is not set
CONFIG_DM_GPIO=y
CONFIG_MT7621_GPIO=y
CONFIG_MTD=y
CONFIG_MTD_PARTITIONS=y
CONFIG_NAND_MT7621=y
CONFIG_SPL_NAND_MT7621=y
CONFIG_DM_ETH=y
CONFIG_MT7621_ETH=y
CONFIG_PINCTRL=y
CONFIG_PINCONF=y
CONFIG_PINCTRL_MT7621=y
CONFIG_DM_RESET=y
CONFIG_MT7621_RESET=y
CONFIG_DM_SERIAL=y
CONFIG_DEBUG_UART_MTK=y
CONFIG_DEBUG_UART_SHIFT=2
CONFIG_MTK_SERIAL=y
CONFIG_LZMA=y
CONFIG_SPL_LZMA=y
CONFIG_WEBUI_FAILSAFE=y
# CONFIG_WEBUI_FAILSAFE_ON_AUTOBOOT_FAIL is not set
CONFIG_DEFAULT_NAND_KERNEL_OFFSET=0x100000
CONFIG_MT7621_CPU_FREQ_LEGACY=880
CONFIG_MT7621_DRAM_FREQ_1200_LEGACY=y
CONFIG_MT7621_DRAM_DDR3_2048M_LEGACY=y
CONFIG_BAUDRATE=115200
CONFIG_FAILSAFE_ON_BUTTON=y
CONFIG_CMD_SAVEENV=y
CONFIG_CMD_NAND=y
CONFIG_CMD_NET=y
CONFIG_CMD_TFTPBOOT=y
CONFIG_ENV_IS_IN_NAND=y
CONFIG_ENV_OFFSET=0x60000
CONFIG_ENV_SIZE=0x20000
CONFIG_ENV_SECT_SIZE=0x20000
```
